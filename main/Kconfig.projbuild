## main/Kconfig.projbuild
```kconfig
menu "番茄钟与聊天助手配置"
    config POMODORO_WORK_MINUTES
        int "默认工作时长（分钟）"
        default 25
        range 1 60
        help
            番茄钟默认工作时长，单位为分钟

    config POMODORO_BREAK_MINUTES
        int "默认休息时长（分钟）"
        default 5
        range 1 30
        help
            番茄钟默认休息时长，单位为分钟

    config NTP_SYNC_INTERVAL
        int "NTP同步间隔（分钟）"
        default 10
        range 0 1440
        help
            NTP时间同步间隔，0表示禁用自动同步

    config TIMEZONE_OFFSET
        int "时区偏移（小时）"
        default 8
        range -12 14
        help
            相对于UTC的时区偏移，例如东八区为+8
endmenu
```

## sdkconfig.defaults
```kconfig
# Partition table - custom large single app for 4MB flash
CONFIG_PARTITION_TABLE_CUSTOM=y
CONFIG_PARTITION_TABLE_CUSTOM_FILENAME="partitions.csv"

# Compiler optimization for size
CONFIG_COMPILER_OPTIMIZATION_SIZE=y

# WiFi buffer reduction (save ~30KB peak DRAM)
CONFIG_ESP_WIFI_STATIC_RX_BUFFER_NUM=4
CONFIG_ESP_WIFI_DYNAMIC_RX_BUFFER_NUM=8
CONFIG_ESP_WIFI_DYNAMIC_TX_BUFFER_NUM=8
CONFIG_ESP_WIFI_MGMT_SBUF_NUM=8

# LWIP reduction (save ~8KB)
CONFIG_LWIP_MAX_SOCKETS=4
CONFIG_LWIP_MAX_ACTIVE_TCP=4
CONFIG_LWIP_MAX_LISTENING_TCP=2
CONFIG_LWIP_MAX_UDP_PCBS=4
CONFIG_LWIP_TCP_SND_BUF_DEFAULT=2880
CONFIG_LWIP_TCP_WND_DEFAULT=2880

# mbedTLS reduction (save ~12KB)
CONFIG_MBEDTLS_SSL_IN_CONTENT_LEN=4096
CONFIG_MBEDTLS_DYNAMIC_BUFFER=y

# Task stack reduction
CONFIG_ESP_MAIN_TASK_STACK_SIZE=2560
CONFIG_ESP_TIMER_TASK_STACK_SIZE=2560

# Disable unused components
# CONFIG_ETH_ENABLED is not set
# CONFIG_ESP_GDBSTUB_ENABLED is not set

# Reduce log overhead
CONFIG_LOG_TAG_LEVEL_IMPL_CACHE_SIZE=8
```
